## conf/layer.conf
```bitbake
# We have a conf and classes directory, add to BBPATH
BBPATH .= ":${LAYERDIR}"

# We have recipes-* directories, add to BBFILES
BBFILES += "${LAYERDIR}/recipes-*/*/*.bb \
	${LAYERDIR}/recipes-*/*/*.bbappend"

BBFILE_COLLECTIONS += "updatehub-atmel"
BBFILE_PATTERN_updatehub-atmel = "^${LAYERDIR}/"
BBFILE_PRIORITY_updatehub-atmel = "6"

LAYERDEPENDS_updatehub-atmel = "updatehub"

###
# Global setting to use UpadateHub with meta-atmel layer
#
IMAGE_BOOT_FILES_updatehub-atmel ??= ""
WKS_FILE_DEPENDS_updatehub-atmel ??= "dosfstools-native mtools-native parted-native virtual/bootloader"
WKS_FILES_updatehub-atmel ??= "updatehub.atmel.wks"
IMAGE_FSTYPES_updatehub-atmel ??= "tar.xz wic.gz"
WKS_SEARCH_PATH_updatehub-atmel ??= "${THISDIR}:${@':'.join('%s/wic' % p for p in '${BBPATH}'.split(':'))}:${@':'.join('%s/scripts/lib/wic/canned-wks' % l for l in '${BBPATH}:${COREBASE}'.split(':'))}"

# UpdateHub settings
UPDATEHUB_ACTIVE_INACTIVE_BACKEND_updatehub-atmel ??= "u-boot"
UPDATEHUB_DEVICE_IDENTITY_updatehub-atmel ??= "primary-iface"
UPDATEHUB_FILESYSTEM_SUPPORT_updatehub-atmel ??= "ext4"
UPDATEHUB_IMAGE_TYPE_updatehub-atmel ??= "active/inactive"
UPDATEHUB_INSTALL_MODE_updatehub-atmel ??= "tarball"

PREFERRED_PROVIDER_u-boot-fw-utils_updatehub-atmel ??= "u-boot-atmel-fw-utils"
PREFERRED_PROVIDER_u-boot_updatehub-atmel ??= "u-boot-at91"
PREFERRED_PROVIDER_virtual/bootloader_updatehub-atmel ??= "u-boot-at91"
KERNEL_IMAGETYPE_updatehub-atmel ??= "zImage"
MACHINE_ESSENTIAL_EXTRA_RDEPENDS_updatehub-atmel += " \
    kernel-image \
    kernel-devicetree \
"

# Do not change fstab file
WIC_CREATE_EXTRA_ARGS_updatehub-atmel ??= "--no-fstab-update"

###
# Configuration for Atmel/Microchip devices
#
MACHINEOVERRIDES_prepend_sama5d27-som1-ek-sd = "updatehub-atmel:"
WKS_FILES_updatehub-atmel_sama5d27-som1-ek-sd ??= "updatehub-atmel.wks"

IMAGE_BOOT_FILES_updatehub-atmel_sama5d27-som1-ek-sd ??= " \
	BOOT.BIN \
	u-boot.bin \
	zImage \
	zImage-at91-sama5d27_som1_ek.dtb;at91-sama5d27_som1_ek.dtb \
	zImage-at91-sama5d27_som1_ek_pda4.dtb;at91-sama5d27_som1_ek_pda4.dtb \
	zImage-at91-sama5d27_som1_ek_pda7.dtb;at91-sama5d27_som1_ek_pda7.dtb \
	zImage-at91-sama5d27_som1_ek_pda7b.dtb;at91-sama5d27_som1_ek_pda7b.dtb \
"
```
